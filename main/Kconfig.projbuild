## main/Kconfig.projbuild
```kconfig
menu "BLE WebSocket Configuration"

    config BLE_WEBSOCKET_URI
        string "WebSocket server URI"
        default "ws://gogo.uno:1885"
        help
            WebSocket server endpoint used by this application.

    config BLE_WEBSOCKET_MESSAGE
        string "WebSocket message"
        default "hello from esp32c5"
        help
            Text message sent once after the WebSocket connection succeeds.

    config BLE_WEBSOCKET_WIFI_SSID
        string "Wi-Fi SSID"
        default "NRadio"
        help
            Wi-Fi network name for station mode.

    config BLE_WEBSOCKET_WIFI_PASSWORD
        string "Wi-Fi password"
        default "A12345678"
        help
            Wi-Fi password for station mode.

endmenu

menu "BLE Configuration"

    orsource "$IDF_PATH/examples/common_components/env_caps/$IDF_TARGET/Kconfig.env_caps"

    choice BLINK_LED
        prompt "Blink LED type"
        default BLINK_LED_STRIP
        help
            Select the LED type. A normal level controlled LED or an addressable LED strip.

        config BLINK_LED_GPIO
            bool "GPIO"

        config BLINK_LED_STRIP
            bool "LED strip"
    endchoice

    choice BLINK_LED_STRIP_BACKEND
        depends on BLINK_LED_STRIP
        prompt "LED strip backend peripheral"
        default BLINK_LED_STRIP_BACKEND_RMT if SOC_RMT_SUPPORTED
        default BLINK_LED_STRIP_BACKEND_RMT
        help
            Select the backend peripheral to drive the LED strip.

        config BLINK_LED_STRIP_BACKEND_RMT
            depends on SOC_RMT_SUPPORTED
            bool "RMT"

        config BLINK_LED_STRIP_BACKEND_SPI
            bool "SPI"
    endchoice

    config BLINK_GPIO
        int "Blink GPIO number"
        range ENV_GPIO_RANGE_MIN ENV_GPIO_OUT_RANGE_MAX
        default 27
        help
            GPIO number (IOxx) used by the LED characteristic.

endmenu
```
